## app/boards/shields/paintbrushchorder/Kconfig.defconfig
```kconfig
# Copyright (c) 2020 The ZMK Contributors
# SPDX-License-Identifier: MIT

if SHIELD_PAINTBRUSHCHORDER_LEFT

config ZMK_KEYBOARD_NAME
    default "paintbrushchorder"

config ZMK_SPLIT_ROLE_CENTRAL
    default y

endif

if SHIELD_PAINTBRUSHCHORDER_LEFT || SHIELD_PAINTBRUSHCHORDER_RIGHT

config ZMK_SPLIT
    default y

endif
```

## app/boards/shields/paintbrushchorder/Kconfig.shield
```kconfig
# Copyright (c) 2020 The ZMK Contributors
# SPDX-License-Identifier: MIT

config SHIELD_PAINTBRUSHCHORDER_LEFT
    def_bool $(shields_list_contains,paintbrushchorder_left)

config SHIELD_PAINTBRUSHCHORDER_RIGHT
    def_bool $(shields_list_contains,paintbrushchorder_right)
```
